## base_external/Config.in
```kconfig
source "$BR2_EXTERNAL_project_base_PATH/package/socket/Config.in"
source "$BR2_EXTERNAL_project_base_PATH/package/tmp/Config.in"
```

## base_external/package/client/Config.in
```kconfig
config BR2_PACKAGE_CLIENT
	bool "client"
	help
	  Includes the files related to Socket and client
```

## base_external/package/gpio/Config.in
```kconfig
config BR2_PACKAGE_GPIO
	bool "gpio"
	help
	  Includes the files related to Gpio
```

## base_external/package/humidity/Config.in
```kconfig
config BR2_PACKAGE_HUMIDITY
	bool "humidity"
	help
	  Includes the files related to DHT11
```

## base_external/package/tmp/Config.in
```kconfig
config BR2_PACKAGE_TEMP
	bool "tmp"
	help
	  Includes the files related to TMP102
```
